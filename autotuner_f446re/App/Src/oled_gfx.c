/*
 * oled_gfx.c — see oled_gfx.h. The classic 5x7 font: one byte per column, bit 0 = top row.
 */
#include "oled_gfx.h"
#include <string.h>

static const uint8_t FONT5X7[95][5] = {
    {0x00,0x00,0x00,0x00,0x00}, /* ' ' */  {0x00,0x00,0x5F,0x00,0x00}, /* '!' */
    {0x00,0x07,0x00,0x07,0x00}, /* '"' */  {0x14,0x7F,0x14,0x7F,0x14}, /* '#' */
    {0x24,0x2A,0x7F,0x2A,0x12}, /* '$' */  {0x23,0x13,0x08,0x64,0x62}, /* '%' */
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    {0x08,0x04,0x08,0x10,0x08}, /* '~' */
};

void oled_fb_clear(oled_fb_t *fb)
{
    memset(fb->buf, 0, sizeof(fb->buf));
}

void oled_fb_pixel(oled_fb_t *fb, int x, int y, int on)
{
    if (x < 0 || x >= OLED_WIDTH || y < 0 || y >= OLED_HEIGHT) return;
    uint8_t *b = &fb->buf[(y / 8) * OLED_WIDTH + x];
    uint8_t mask = (uint8_t)(1u << (y % 8));
    if (on) *b |= mask;
    else    *b &= (uint8_t)~mask;
}

static void draw_char(oled_fb_t *fb, int x, int y, char c, int scale)
{
    if (c < 32 || c > 126) c = '?';
    const uint8_t *g = FONT5X7[c - 32];
    for (int col = 0; col < 5; col++)
        for (int row = 0; row < 7; row++)
            if (g[col] & (1u << row))
                for (int dx = 0; dx < scale; dx++)
                    for (int dy = 0; dy < scale; dy++)
                        oled_fb_pixel(fb, x + col * scale + dx, y + row * scale + dy, 1);
}

int oled_fb_text(oled_fb_t *fb, int x, int y, const char *text, int scale)
{
    if (scale < 1) scale = 1;
    for (; *text; text++) {
        draw_char(fb, x, y, *text, scale);
        x += 6 * scale;
    }
    return x;
}

int oled_fb_text_width(const char *text, int scale)
{
    int n = 0;
    while (text[n]) n++;
    return n > 0 ? n * 6 * scale - scale : 0;      /* no gap after the last character */
}
